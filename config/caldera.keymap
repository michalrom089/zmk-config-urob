#define CONFIG_WIRELESS
#define ZMK_BASE_LAYER(name, LT, RT, LM, RM, LB, RB, LH, RH)                                      \
    ZMK_LAYER(                                                                                    \
        name,                                                                                     \
        &kp EQUAL &kp N1 &kp N2 &kp N3 &kp N4 &kp N5 &kp N6 &kp N7 &kp N8 &kp N9 &kp N0 &kp MINUS \
        &kp TAB              LT                                            RT           &kp BSPC  \
        &kp ESC              LM                                            RM           &none     \
        &kp LSHIFT               LB                                            RB           &none     \
        &kp LCTRL  &kp RIGHT  &none &none LH                                            RH   &none &none &kp UP &kp DOWN  )

#include "zmk-helpers/key-labels/5x6.h"
#include "base.keymap"
